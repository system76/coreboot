## src/mainboard/system76/kudu6/Kconfig
```kconfig
if BOARD_SYSTEM76_KUDU6

config BOARD_SPECIFIC_OPTIONS
	def_bool y
	select AMD_SOC_CONSOLE_UART
	select BOARD_ROMSIZE_KB_16384
	select DRIVERS_GFX_NVIDIA
	select DRIVERS_I2C_HID
	select EC_SYSTEM76_EC
	select EC_SYSTEM76_EC_BAT_THRESHOLDS
	select EC_SYSTEM76_EC_COLOR_KEYBOARD
	select EC_SYSTEM76_EC_DGPU
	select HAVE_ACPI_RESUME
	select HAVE_ACPI_TABLES
	select MAINBOARD_HAS_LPC_TPM
	select MAINBOARD_HAS_TPM2
	select PCIEXP_ASPM
	select PCIEXP_CLK_PM
	select PCIEXP_COMMON_CLOCK
	select PCIEXP_L1_SUB_STATE
	select NO_UART_ON_SUPERIO
	select SOC_AMD_CEZANNE
	select SOC_AMD_COMMON_BLOCK_GRAPHICS_ATIF
	select SPD_READ_BY_WORD
	select SYSTEM_TYPE_LAPTOP
	select TPM_RDRESP_NEED_DELAY

config MAINBOARD_DIR
	default "system76/kudu6"

config MAINBOARD_PART_NUMBER
	default "kudu6"

config MAINBOARD_SMBIOS_PRODUCT_NAME
	default "Kudu"

config MAINBOARD_VERSION
	default "kudu6"

config AMD_FWM_POSITION_INDEX
	default 3

config AMDFW_CONFIG_FILE
	default "src/mainboard/\$(CONFIG_MAINBOARD_DIR)/amdfw.cfg"

config CBFS_SIZE
	default 0xA00000

config CONSOLE_POST
	default y

config DIMM_MAX
	default 4

config DIMM_SPD_SIZE
	default 512

config EFS_SPI_READ_MODE
	default 5          # Quad IO (1-4-4)

config EFS_SPI_SPEED
	default 0	# 66MHz

config EFS_SPI_MICRON_FLAG
	default 2

config NORMAL_READ_SPI_SPEED
	default 1	# 33MHz

config ALT_SPI_SPEED
	default 0	# 66MHz

config ONBOARD_VGA_IS_PRIMARY
	default y

config POST_DEVICE
	default n

config PSP_POSTCODES_ON_ESPI
	default n

config UART_FOR_CONSOLE
	default 0

endif
```

## src/mainboard/system76/lemp10/Kconfig
```kconfig
if BOARD_SYSTEM76_LEMP10

config BOARD_SPECIFIC_OPTIONS
	def_bool y
	select BOARD_ROMSIZE_KB_16384
	select DRIVERS_I2C_HID
	select DRIVERS_INTEL_PMC
	select DRIVERS_INTEL_USB4_RETIMER
	select EC_SYSTEM76_EC
	select EC_SYSTEM76_EC_BAT_THRESHOLDS
	select HAVE_ACPI_TABLES
	select HAVE_SMI_HANDLER
	select HAVE_SPD_IN_CBFS
	select INTEL_GMA_HAVE_VBT
	select INTEL_LPSS_UART_FOR_CONSOLE
	select MAINBOARD_HAS_LPC_TPM
	select MAINBOARD_HAS_TPM2
	select NO_UART_ON_SUPERIO
	select PCIEXP_HOTPLUG
	select SOC_INTEL_TIGERLAKE
	select SOC_INTEL_COMMON_BLOCK_HDA
	select SOC_INTEL_COMMON_BLOCK_HDA_VERB
	select SPD_READ_BY_WORD
	select SYSTEM_TYPE_LAPTOP
	select TPM_RDRESP_NEED_DELAY
	select USE_LEGACY_8254_TIMER # Fix failure to boot GRUB

config MAINBOARD_DIR
	string
	default "system76/lemp10"

config MAINBOARD_PART_NUMBER
	string
	default "lemp10"

config MAINBOARD_SMBIOS_PRODUCT_NAME
	string
	default "Lemur Pro"

config MAINBOARD_VERSION
	string
	default "lemp10"

config CBFS_SIZE
	hex
	default 0xA00000

config CONSOLE_POST
	bool
	default y

config UART_FOR_CONSOLE
	int
	default 2

config MAX_CPUS
	int
	default 8

config DIMM_MAX
	int
	default 4 # Hack to make soc code work

config DIMM_SPD_SIZE
	int
	default 512

config POST_DEVICE
	bool
	default n

endif
```

## src/mainboard/system76/meer9/Kconfig
```kconfig
## SPDX-License-Identifier: GPL-2.0-only

config BOARD_SYSTEM76_MEER9_COMMON
	def_bool n
	select BOARD_ROMSIZE_KB_32768
	select DRIVERS_UART_8250IO
	select DRIVERS_GENERIC_CBFS_SERIAL
	select DRIVERS_GENERIC_CBFS_UUID
	select HAVE_ACPI_RESUME
	select HAVE_ACPI_TABLES
	select HAVE_CMOS_DEFAULT
	select HAVE_OPTION_TABLE
	select INTEL_GMA_HAVE_VBT
	select MAINBOARD_HAS_TPM2
	select MEMORY_MAPPED_TPM
	select NO_UART_ON_SUPERIO
	select PCIEXP_SUPPORT_RESIZABLE_BARS
	select SOC_INTEL_COMMON_BLOCK_HDA_VERB
	select SOC_INTEL_CRASHLOG
	select SOC_INTEL_METEORLAKE
	select SPD_READ_BY_WORD
	select SYSTEM_TYPE_LAPTOP
	select TPM_RDRESP_NEED_DELAY

config BOARD_SYSTEM76_MEER9
	select BOARD_SYSTEM76_MEER9_COMMON
	select SOC_INTEL_ENABLE_USB4_PCIE_RESOURCES
	select SOC_INTEL_METEORLAKE_U_H

if BOARD_SYSTEM76_MEER9_COMMON

config MAINBOARD_DIR
	default "system76/meer9"

config VARIANT_DIR
	default "meer9" if BOARD_SYSTEM76_MEER9

config OVERRIDE_DEVICETREE
	default "variants/\$(CONFIG_VARIANT_DIR)/overridetree.cb"

config MAINBOARD_PART_NUMBER
	default "meer9" if BOARD_SYSTEM76_MEER9

config MAINBOARD_SMBIOS_PRODUCT_NAME
	default "Meerkat" if BOARD_SYSTEM76_MEER9

config MAINBOARD_VERSION
	default "meer9" if BOARD_SYSTEM76_MEER9

config CMOS_DEFAULT_FILE
	default "src/mainboard/\$(MAINBOARDDIR)/cmos.default"

config CONSOLE_POST
	default y

config D3COLD_SUPPORT
	default n

config DIMM_SPD_SIZE
	default 1024

config FMDFILE
	default "src/mainboard/\$(CONFIG_MAINBOARD_DIR)/variants/\$(CONFIG_VARIANT_DIR)/board.fmd"

config ONBOARD_VGA_IS_PRIMARY
	default y

config PCIEXP_DEFAULT_MAX_RESIZABLE_BAR_BITS
	default 36

config POST_DEVICE
	default n

config TPM_MEASURED_BOOT
	default y

config UART_FOR_CONSOLE
	default 0

# PM Timer Disabled, saves power
config USE_PM_ACPI_TIMER
	default n

endif
```

## src/mainboard/system76/meer9/Kconfig.name
```kconfig
## SPDX-License-Identifier: GPL-2.0-only

config BOARD_SYSTEM76_MEER9
	bool "meer9"
```

## src/mainboard/system76/mtl/Kconfig.name
```kconfig
## SPDX-License-Identifier: GPL-2.0-only

config BOARD_SYSTEM76_LEMP13
	bool "lemp13"
```

## src/mainboard/system76/oryp4/Kconfig
```kconfig
if BOARD_SYSTEM76_ORYP4

config BOARD_SPECIFIC_OPTIONS
	def_bool y
	select BOARD_ROMSIZE_KB_16384
	select DRIVERS_I2C_HID
	select HAVE_ACPI_RESUME
	select HAVE_ACPI_TABLES
	select HAVE_CMOS_DEFAULT
	select HAVE_OPTION_TABLE
	select INTEL_GMA_HAVE_VBT
	select INTEL_LPSS_UART_FOR_CONSOLE
	select MAINBOARD_HAS_LPC_TPM
	select MAINBOARD_HAS_TPM2
	select NO_UART_ON_SUPERIO
	select SOC_INTEL_CANNONLAKE_PCH_H
	select SOC_INTEL_COFFEELAKE
	select SOC_INTEL_COMMON_BLOCK_HDA_VERB
	select SPD_READ_BY_WORD
	select SYSTEM_TYPE_LAPTOP

config MAINBOARD_DIR
	default "system76/oryp4"

config MAINBOARD_PART_NUMBER
	default "oryp4"

config MAINBOARD_SMBIOS_PRODUCT_NAME
	default "Oryx Pro"

config MAINBOARD_VERSION
	default "oryp4"

config CBFS_SIZE
	default 0xA00000

config CONSOLE_POST
	default y

config ONBOARD_VGA_IS_PRIMARY
	default y

config UART_FOR_CONSOLE
	default 2

config DIMM_MAX
	default 2

config POST_DEVICE
	default n

endif
```

## src/mainboard/system76/ptl/Kconfig
```kconfig
## SPDX-License-Identifier: GPL-2.0-only

config BOARD_SYSTEM76_PTL_COMMON
	def_bool n
	select BOARD_ROMSIZE_KB_32768
	select CSE_DEFAULT_CFR_OPTION_STATE_DISABLED
	select DRIVERS_EFI_VARIABLE_STORE
	select DRIVERS_GENERIC_BAYHUB_LV2
	select DRIVERS_GENERIC_CBFS_SERIAL
	select DRIVERS_GENERIC_CBFS_UUID
	select DRIVERS_I2C_HID
	select DRIVERS_OPTION_CFR_ENABLED
	select EC_SYSTEM76_EC
	select HAVE_ACPI_RESUME
	select HAVE_ACPI_TABLES
	select INTEL_GMA_HAVE_VBT
	select INTEL_LPSS_UART_FOR_CONSOLE
	select MAINBOARD_HAS_TPM2
	select MEMORY_MAPPED_TPM
	select NO_UART_ON_SUPERIO
	select PCIEXP_SUPPORT_RESIZABLE_BARS
	select SOC_INTEL_COMMON_BLOCK_HDA_VERB
	select SOC_INTEL_CRASHLOG
	select SOC_INTEL_PANTHERLAKE_U_H
	select SPD_READ_BY_WORD
	select SYSTEM_TYPE_LAPTOP

config BOARD_SYSTEM76_LEMP14
	select BOARD_SYSTEM76_PTL_COMMON
	select DRIVERS_I2C_TAS5825M
	select HAVE_SPD_IN_CBFS
	select SOC_INTEL_ENABLE_USB4_PCIE_RESOURCES

if BOARD_SYSTEM76_PTL_COMMON

config MAINBOARD_DIR
	default "system76/ptl"

config VARIANT_DIR
	default "lemp14" if BOARD_SYSTEM76_LEMP14

config OVERRIDE_DEVICETREE
	default "variants/\$(CONFIG_VARIANT_DIR)/overridetree.cb"

config MAINBOARD_PART_NUMBER
	default "lemp14" if BOARD_SYSTEM76_LEMP14

config MAINBOARD_SMBIOS_PRODUCT_NAME
	default "Lemur Pro" if BOARD_SYSTEM76_LEMP14

config MAINBOARD_VERSION
	default "lemp14" if BOARD_SYSTEM76_LEMP14

config CONSOLE_POST
	default y

config D3COLD_SUPPORT
	default n

config DIMM_SPD_SIZE
	default 512

config FMDFILE
	default "src/mainboard/\$(CONFIG_MAINBOARD_DIR)/variants/\$(CONFIG_VARIANT_DIR)/board.fmd"

config ONBOARD_VGA_IS_PRIMARY
	default y

config PCIEXP_DEFAULT_MAX_RESIZABLE_BAR_BITS
	default 36

config POST_DEVICE
	default n

config TPM_MEASURED_BOOT
	default y

config UART_FOR_CONSOLE
	default 0

# PM Timer Disabled, saves power
config USE_PM_ACPI_TIMER
	default n

endif
```

## src/mainboard/system76/ptl/Kconfig.name
```kconfig
## SPDX-License-Identifier: GPL-2.0-only

config BOARD_SYSTEM76_LEMP14
	bool "lemp14"

config BOARD_SYSTEM76_LEMP14_B
	bool "lemp14-b"
```

## src/mainboard/system76/rpl/Kconfig
```kconfig
config BOARD_SYSTEM76_RPL_COMMON
	def_bool n
	select BOARD_ROMSIZE_KB_32768
	select DRIVERS_I2C_HID
	select EC_SYSTEM76_EC
	select EC_SYSTEM76_EC_LOCKDOWN
	select HAVE_ACPI_RESUME
	select HAVE_ACPI_TABLES
	select HAVE_CMOS_DEFAULT
	select HAVE_OPTION_TABLE
	select INTEL_GMA_HAVE_VBT
	select INTEL_LPSS_UART_FOR_CONSOLE
	select MAINBOARD_HAS_TPM2
	select MEMORY_MAPPED_TPM
	select NO_UART_ON_SUPERIO
	select PCIEXP_SUPPORT_RESIZABLE_BARS
	select SOC_INTEL_ALDERLAKE_S3
	select SOC_INTEL_COMMON_BLOCK_HDA_VERB
	select SOC_INTEL_CRASHLOG
	select SOC_INTEL_RAPTORLAKE
	select SPD_READ_BY_WORD
	select SYSTEM_TYPE_LAPTOP

config BOARD_SYSTEM76_ADDW3
	def_bool n
	select BOARD_SYSTEM76_RPL_COMMON
	select DRIVERS_GFX_NVIDIA
	select EC_SYSTEM76_EC_COLOR_KEYBOARD
	select EC_SYSTEM76_EC_DGPU
	select MAINBOARD_USES_IFD_GBE_REGION
	select PCIEXP_HOTPLUG
	select SOC_INTEL_ALDERLAKE_PCH_S

config BOARD_SYSTEM76_BONW15
	def_bool n
	select BOARD_SYSTEM76_RPL_COMMON
	select DRIVERS_GFX_NVIDIA
	select EC_SYSTEM76_EC_COLOR_KEYBOARD
	select EC_SYSTEM76_EC_DGPU
	select PCIEXP_HOTPLUG
	select SOC_INTEL_ALDERLAKE_PCH_S

config BOARD_SYSTEM76_GAZE18
	def_bool n
	select BOARD_SYSTEM76_RPL_COMMON
	select DRIVERS_GFX_NVIDIA
	select EC_SYSTEM76_EC_COLOR_KEYBOARD
	select EC_SYSTEM76_EC_DGPU
	select SOC_INTEL_ALDERLAKE_PCH_P
	select TPM_RDRESP_NEED_DELAY

config BOARD_SYSTEM76_ORYP11
	def_bool n
	select BOARD_SYSTEM76_RPL_COMMON
	select DRIVERS_GFX_NVIDIA
	select EC_SYSTEM76_EC_COLOR_KEYBOARD
	select EC_SYSTEM76_EC_DGPU
	select SOC_INTEL_ALDERLAKE_PCH_P
	select SOC_INTEL_ENABLE_USB4_PCIE_RESOURCES

config BOARD_SYSTEM76_SERW13
	def_bool n
	select BOARD_SYSTEM76_RPL_COMMON
	select DRIVERS_GFX_NVIDIA
	select EC_SYSTEM76_EC_COLOR_KEYBOARD
	select EC_SYSTEM76_EC_DGPU
	select PCIEXP_HOTPLUG
	select SOC_INTEL_ALDERLAKE_PCH_S

if BOARD_SYSTEM76_RPL_COMMON

config MAINBOARD_DIR
	default "system76/rpl"

config VARIANT_DIR
	default "addw3" if BOARD_SYSTEM76_ADDW3
	default "bonw15" if BOARD_SYSTEM76_BONW15
	default "gaze18" if BOARD_SYSTEM76_GAZE18
	default "oryp11" if BOARD_SYSTEM76_ORYP11
	default "serw13" if BOARD_SYSTEM76_SERW13

config OVERRIDE_DEVICETREE
	default "variants/\$(CONFIG_VARIANT_DIR)/overridetree.cb"

config MAINBOARD_PART_NUMBER
	default "addw3" if BOARD_SYSTEM76_ADDW3
	default "bonw15" if BOARD_SYSTEM76_BONW15
	default "gaze18" if BOARD_SYSTEM76_GAZE18
	default "oryp11" if BOARD_SYSTEM76_ORYP11
	default "serw13" if BOARD_SYSTEM76_SERW13

config MAINBOARD_SMBIOS_PRODUCT_NAME
	default "Adder WS" if BOARD_SYSTEM76_ADDW3
	default "Bonobo WS" if BOARD_SYSTEM76_BONW15
	default "Gazelle" if BOARD_SYSTEM76_GAZE18
	default "Oryx Pro" if BOARD_SYSTEM76_ORYP11
	default "Serval WS" if BOARD_SYSTEM76_SERW13

config MAINBOARD_VERSION
	default "addw3" if BOARD_SYSTEM76_ADDW3
	default "bonw15" if BOARD_SYSTEM76_BONW15
	default "gaze18" if BOARD_SYSTEM76_GAZE18
	default "oryp11" if BOARD_SYSTEM76_ORYP11
	default "serw13" if BOARD_SYSTEM76_SERW13

config CONSOLE_POST
	default y

config DIMM_SPD_SIZE
	default 512

config FMDFILE
	default "src/mainboard/\$(CONFIG_MAINBOARD_DIR)/variants/\$(CONFIG_VARIANT_DIR)/board.fmd"

config ONBOARD_VGA_IS_PRIMARY
	default y

config PCIEXP_DEFAULT_MAX_RESIZABLE_BAR_BITS
	default 36

config POST_DEVICE
	default n

config TPM_MEASURED_BOOT
	default y

config UART_FOR_CONSOLE
	default 0 if BOARD_SYSTEM76_GAZE18 || BOARD_SYSTEM76_ORYP11
	default 2 if BOARD_SYSTEM76_ADDW3 || BOARD_SYSTEM76_BONW15 || BOARD_SYSTEM76_SERW13

# PM Timer Disabled, saves power
config USE_PM_ACPI_TIMER
	default n

endif

if BOARD_SYSTEM76_BONW15

config DRIVERS_GFX_NVIDIA_BRIDGE
	default 0x02

endif
```

## src/mainboard/system76/rpl/Kconfig.name
```kconfig
config BOARD_SYSTEM76_ADDP3
	bool "addp3"

config BOARD_SYSTEM76_GAZE18_3050
	bool "gaze18-3050"

config BOARD_SYSTEM76_GAZE18_40X0
	bool "gaze18-40x0"

config BOARD_SYSTEM76_ORYP11
	bool "oryp11"
```
