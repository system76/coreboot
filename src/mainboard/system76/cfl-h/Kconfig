## src/mainboard/system76/cfl-h/Kconfig
```kconfig
if BOARD_SYSTEM76_GAZE14_1650_15 || BOARD_SYSTEM76_GAZE14_1650_17 || BOARD_SYSTEM76_GAZE14_1660TI_15 || BOARD_SYSTEM76_GAZE14_1660TI_17

config BOARD_SPECIFIC_OPTIONS
	def_bool y
	select ADD_FSP_BINARIES
	select BOARD_ROMSIZE_KB_16384
	select EC_ACPI
	select EXCLUDE_EMMC_INTERFACE
	select FSP_USE_REPO
	select HAVE_ACPI_RESUME
	select HAVE_ACPI_TABLES
	select HAVE_SMI_HANDLER
	select INTEL_GMA_HAVE_VBT
#	select MAINBOARD_HAS_SPI_TPM_CR50
#	select MAINBOARD_HAS_TPM2
	select SOC_INTEL_CANNONLAKE_PCH_H
	select SOC_INTEL_COFFEELAKE
	select SOC_INTEL_COMMON_ACPI_EC_PTS_WAK
	select SOC_INTEL_COMMON_BLOCK_HDA
	select SOC_INTEL_COMMON_BLOCK_HDA_VERB
	select SPD_READ_BY_WORD
	select SYSTEM_TYPE_LAPTOP
	select USE_BLOBS

config MAINBOARD_DIR
	string
	default system76/cfl-h

config VARIANT_DIR
	string
	default "gaze14_1650_15" if BOARD_SYSTEM76_GAZE14_1650_15
	default "gaze14_1650_17" if BOARD_SYSTEM76_GAZE14_1650_17
	default "gaze14_1660ti_15" if BOARD_SYSTEM76_GAZE14_1660TI_15
	default "gaze14_1660ti_17" if BOARD_SYSTEM76_GAZE14_1660TI_17

config MAINBOARD_PART_NUMBER
	string
	default "gaze14"

config CBFS_SIZE
	hex
	default 0xA00000

config MAINBOARD_PCI_SUBSYSTEM_VENDOR_ID
	hex
	default 0x1558

config MAINBOARD_PCI_SUBSYSTEM_DEVICE_ID
	hex
	default 0x8560 if BOARD_SYSTEM76_GAZE14_1650_15
	default 0x8561 if BOARD_SYSTEM76_GAZE14_1650_17
	default 0x8550 if BOARD_SYSTEM76_GAZE14_1660TI_15
	default 0x8551 if BOARD_SYSTEM76_GAZE14_1660TI_17

config CONSOLE_POST
	bool
	default y

config ONBOARD_VGA_IS_PRIMARY
	bool
	default y

# This causes UEFI to hang
#config UART_FOR_CONSOLE
#	int
#	default 2

config MAX_CPUS
	int
	default 12

config DIMM_MAX
	int
	default 2

config DIMM_SPD_SIZE
	int
	default 512

# config VGA_BIOS_FILE
# 	string
# 	default "pci8086,3ea0.rom"

# config VGA_BIOS_ID
# 	string
# 	default "8086,3ea0"

config PXE_ROM_ID
	string
	default "10ec,8168"

config FSP_M_XIP
	bool
	default y

config POST_DEVICE
	bool
	default n

#config DRIVER_TPM_SPI_BUS
#	hex
#	default 0x0

#config DRIVER_TPM_SPI_CHIP
#	int
#	default 2

endif
```

## src/mainboard/system76/cml-u/Kconfig
```kconfig
if BOARD_SYSTEM76_GALP4 || BOARD_SYSTEM76_DARP6

config BOARD_SPECIFIC_OPTIONS
	def_bool y
	select BOARD_ROMSIZE_KB_16384
	select DRIVERS_I2C_HID
	select EC_ACPI
	select EC_SYSTEM76
	select HAVE_ACPI_RESUME
	select HAVE_ACPI_TABLES
	select HAVE_CMOS_DEFAULT
	select HAVE_OPTION_TABLE
	select HAVE_SMI_HANDLER
	select INTEL_GMA_HAVE_VBT
	select INTEL_LPSS_UART_FOR_CONSOLE
	select MAINBOARD_HAS_LPC_TPM
	select MAINBOARD_HAS_TPM2
	select NO_UART_ON_SUPERIO
	select PCIEXP_HOTPLUG
	select SOC_INTEL_COMETLAKE
	select SOC_INTEL_COMMON_ACPI_EC_PTS_WAK
	select SOC_INTEL_COMMON_BLOCK_HDA
	select SOC_INTEL_COMMON_BLOCK_HDA_VERB
	select SPD_READ_BY_WORD
	select SYSTEM_TYPE_LAPTOP
	select USE_OPTION_TABLE
	select USE_LEGACY_8254_TIMER # Fix failure to boot GRUB

config MAINBOARD_DIR
	string
	default system76/cml-u

config VARIANT_DIR
	string
	default "galp4" if BOARD_SYSTEM76_GALP4
	default "darp6" if BOARD_SYSTEM76_DARP6

config OVERRIDE_DEVICETREE
	string
	default "variants/$(CONFIG_VARIANT_DIR)/overridetree.cb"

config MAINBOARD_PART_NUMBER
	string
	default "galp4" if BOARD_SYSTEM76_GALP4
	default "darp6" if BOARD_SYSTEM76_DARP6

config CBFS_SIZE
	hex
	default 0xA00000

config SUBSYSTEM_VENDOR_ID
	hex
	default 0x1558

config SUBSYSTEM_DEVICE_ID
	hex
	default 0x1403 if BOARD_SYSTEM76_GALP4
	default 0x1404 if BOARD_SYSTEM76_DARP6

config CONSOLE_POST
	bool
	default y

config ONBOARD_VGA_IS_PRIMARY
	bool
	default y

config UART_FOR_CONSOLE
	int
	default 2

config MAX_CPUS
	int
	default 8

config DIMM_MAX
	int
	default 2

config DIMM_SPD_SIZE
	int
	default 512

config VGA_BIOS_FILE
	string
	default "pci8086,9b41.rom"

config VGA_BIOS_ID
	string
	default "8086,9b41"

config PXE_ROM_ID
	string
	default "10ec,8168"

config FSP_M_XIP
	bool
	default y

config POST_DEVICE
	bool
	default n

endif
```

## src/mainboard/system76/cnl-h/Kconfig
```kconfig
## SPDX-License-Identifier: GPL-2.0-only

config BOARD_SYSTEM76_CNL_H_COMMON
	def_bool n
	select AZALIA_USE_LEGACY_VERB_TABLE
	select BOARD_ROMSIZE_KB_16384
	select DRIVERS_GENERIC_CBFS_SERIAL
	select DRIVERS_GENERIC_CBFS_UUID
	select DRIVERS_I2C_HID
	select DRIVERS_I2C_TAS5825M
	select EC_SYSTEM76_EC
	select EC_SYSTEM76_EC_DGPU
	select HAVE_ACPI_RESUME
	select HAVE_ACPI_TABLES
	select HAVE_CMOS_DEFAULT
	select HAVE_OPTION_TABLE
	select INTEL_GMA_HAVE_VBT
	select MEMORY_MAPPED_TPM
	select MAINBOARD_HAS_TPM2
	select NO_UART_ON_SUPERIO
	select SOC_INTEL_CANNONLAKE_PCH_H
	select SOC_INTEL_COMMON_BLOCK_HDA_VERB
	select SPD_READ_BY_WORD
	select SYSTEM_TYPE_LAPTOP
	select TPM_MEASURED_BOOT

config BOARD_SYSTEM76_ORYP5
	select BOARD_SYSTEM76_CNL_H_COMMON
	select INTEL_LPSS_UART_FOR_CONSOLE
	select SOC_INTEL_COFFEELAKE

config BOARD_SYSTEM76_ORYP6
	select BOARD_SYSTEM76_CNL_H_COMMON
	select SOC_INTEL_COMETLAKE_1
	select PCIEXP_HOTPLUG
	select PCIEXP_HOTPLUG_PREFETCH_MEM_BELOW_4G # Fix running out of MTRRs

config BOARD_SYSTEM76_ORYP7
	select BOARD_SYSTEM76_CNL_H_COMMON
	select SOC_INTEL_COMETLAKE_1
	select PCIEXP_HOTPLUG
	select PCIEXP_HOTPLUG_PREFETCH_MEM_BELOW_4G # Fix running out of MTRRs

if BOARD_SYSTEM76_CNL_H_COMMON

config MAINBOARD_DIR
	default "system76/cnl-h"

config VARIANT_DIR
	default "oryp5" if BOARD_SYSTEM76_ORYP5
	default "oryp6" if BOARD_SYSTEM76_ORYP6
	default "oryp7" if BOARD_SYSTEM76_ORYP7

config OVERRIDE_DEVICETREE
	default "variants/\$(CONFIG_VARIANT_DIR)/overridetree.cb"

config MAINBOARD_PART_NUMBER
	default "oryp5" if BOARD_SYSTEM76_ORYP5
	default "oryp6" if BOARD_SYSTEM76_ORYP6
	default "oryp7" if BOARD_SYSTEM76_ORYP7

config MAINBOARD_SMBIOS_PRODUCT_NAME
	default "Oryx Pro"

config MAINBOARD_VERSION
	default "oryp5" if BOARD_SYSTEM76_ORYP5
	default "oryp6" if BOARD_SYSTEM76_ORYP6
	default "oryp7" if BOARD_SYSTEM76_ORYP7

config CBFS_SIZE
	default 0xa00000 if SOC_INTEL_COFFEELAKE
	default 0xc00000 if SOC_INTEL_COMETLAKE_1

config CONSOLE_POST
	default y

config ONBOARD_VGA_IS_PRIMARY
	default y

config UART_FOR_CONSOLE
	default 2 if INTEL_LPSS_UART_FOR_CONSOLE

config DIMM_MAX
	default 2

config POST_DEVICE
	default n

endif
```

## src/mainboard/system76/cnl-h/Kconfig.name
```kconfig
## SPDX-License-Identifier: GPL-2.0-only

config BOARD_SYSTEM76_ADDW1
	bool "addw1"

config BOARD_SYSTEM76_ADDW2
	bool "addw2"

config BOARD_SYSTEM76_GAZE14
	bool "gaze14"

config BOARD_SYSTEM76_GAZE15
	bool "gaze15"

config BOARD_SYSTEM76_ORYP5
	bool "oryp5"

config BOARD_SYSTEM76_ORYP6
	bool "oryp6"

config BOARD_SYSTEM76_ORYP7
	bool "oryp7"
```

## src/mainboard/system76/darp7/Kconfig
```kconfig
if BOARD_SYSTEM76_DARP7

config BOARD_SPECIFIC_OPTIONS
	def_bool y
	select BOARD_ROMSIZE_KB_16384
	select DRIVERS_I2C_HID
	select DRIVERS_INTEL_PMC
	select DRIVERS_INTEL_USB4_RETIMER
	select EC_SYSTEM76_EC
	select EC_SYSTEM76_EC_BAT_THRESHOLDS
	select EC_SYSTEM76_EC_COLOR_KEYBOARD
	select HAVE_ACPI_TABLES
	select HAVE_CMOS_DEFAULT
	select HAVE_OPTION_TABLE
	select HAVE_SMI_HANDLER
	select INTEL_GMA_HAVE_VBT
	select INTEL_LPSS_UART_FOR_CONSOLE
	select MAINBOARD_HAS_LPC_TPM
	select MAINBOARD_HAS_TPM2
	select NO_UART_ON_SUPERIO
	select PCIEXP_HOTPLUG
	select SOC_INTEL_TIGERLAKE
	select SOC_INTEL_COMMON_BLOCK_HDA
	select SOC_INTEL_COMMON_BLOCK_HDA_VERB
	select SPD_READ_BY_WORD
	select SYSTEM_TYPE_LAPTOP
	select TPM_RDRESP_NEED_DELAY
	select USE_OPTION_TABLE

config MAINBOARD_DIR
	string
	default "system76/darp7"

config MAINBOARD_PART_NUMBER
	string
	default "darp7"

config MAINBOARD_SMBIOS_PRODUCT_NAME
	string
	default "Darter Pro"

config MAINBOARD_VERSION
	string
	default "darp7"

#TODO: subsystem IDs

config CBFS_SIZE
	hex
	default 0xA00000

config CONSOLE_POST
	bool
	default y

config DIMM_MAX
	int
	default 4 # Hack to make soc code work

config DIMM_SPD_SIZE
	int
	default 512

config MAX_CPUS
	int
	default 8

config POST_DEVICE
	bool
	default n

config UART_FOR_CONSOLE
	int
	default 2

endif
```

## src/mainboard/system76/galp5/Kconfig
```kconfig
if BOARD_SYSTEM76_GALP5

config BOARD_SPECIFIC_OPTIONS
	def_bool y
	select BOARD_ROMSIZE_KB_16384
	select DRIVERS_I2C_HID
	select DRIVERS_INTEL_PMC
	#TODO select DRIVERS_SYSTEM76_DGPU
	select EC_SYSTEM76_EC
	#TODO select EC_SYSTEM76_EC_BAT_THRESHOLDS
	select EC_SYSTEM76_EC_DGPU
	select HAVE_ACPI_RESUME
	select HAVE_ACPI_TABLES
	select HAVE_SMI_HANDLER
	select INTEL_GMA_HAVE_VBT
	select INTEL_LPSS_UART_FOR_CONSOLE
	select MAINBOARD_HAS_LPC_TPM
	select MAINBOARD_HAS_TPM2
	select NO_UART_ON_SUPERIO
	select PCIEXP_HOTPLUG
	select SERIRQ_CONTINUOUS_MODE
	select SOC_INTEL_TIGERLAKE
	select SOC_INTEL_COMMON_BLOCK_HDA
	select SOC_INTEL_COMMON_BLOCK_HDA_VERB
	select SPD_READ_BY_WORD
	select SYSTEM_TYPE_LAPTOP
	select TPM_RDRESP_NEED_DELAY
	select USE_LEGACY_8254_TIMER # Fix failure to boot GRUB

config MAINBOARD_DIR
	string
	default "system76/galp5"

config MAINBOARD_PART_NUMBER
	string
	default "galp5"

config MAINBOARD_SMBIOS_PRODUCT_NAME
	string
	default "Galago Pro"

config MAINBOARD_VERSION
	string
	default "galp5"

#TODO: subsystem IDs

config CBFS_SIZE
	hex
	default 0xA00000

config CONSOLE_POST
	bool
	default y

config ONBOARD_VGA_IS_PRIMARY
	bool
	default y

config UART_FOR_CONSOLE
	int
	default 2

config MAX_CPUS
	int
	default 8

config DIMM_MAX
	int
	default 4 # Hack to make soc code work

config DIMM_SPD_SIZE
	int
	default 512

config POST_DEVICE
	bool
	default n

endif
```

## src/mainboard/system76/gaze14/Kconfig
```kconfig
if BOARD_SYSTEM76_GAZE14_1650_15 || BOARD_SYSTEM76_GAZE14_1650_17 || BOARD_SYSTEM76_GAZE14_1660TI_15 || BOARD_SYSTEM76_GAZE14_1660TI_17

config BOARD_SPECIFIC_OPTIONS
	def_bool y
	select BOARD_ROMSIZE_KB_16384
	select DRIVERS_I2C_HID
	select DRIVERS_SYSTEM76_DGPU
	select EC_SYSTEM76_EC
	select HAVE_ACPI_RESUME
	select HAVE_ACPI_TABLES
	select HAVE_SMI_HANDLER
	select INTEL_GMA_HAVE_VBT
	select INTEL_LPSS_UART_FOR_CONSOLE
	select MAINBOARD_HAS_LPC_TPM
	select MAINBOARD_HAS_TPM2
	select NO_UART_ON_SUPERIO
	select SOC_INTEL_CANNONLAKE_PCH_H
	select SOC_INTEL_COFFEELAKE
	select SOC_INTEL_COMMON_BLOCK_HDA
	select SOC_INTEL_COMMON_BLOCK_HDA_VERB
	select SPD_READ_BY_WORD
	select SYSTEM_TYPE_LAPTOP
	select USE_LEGACY_8254_TIMER # Fix failure to boot GRUB

config MAINBOARD_DIR
	string
	default system76/gaze14

config VARIANT_DIR
	string
	default "gaze14_1650_15" if BOARD_SYSTEM76_GAZE14_1650_15
	default "gaze14_1650_17" if BOARD_SYSTEM76_GAZE14_1650_17
	default "gaze14_1660ti_15" if BOARD_SYSTEM76_GAZE14_1660TI_15
	default "gaze14_1660ti_17" if BOARD_SYSTEM76_GAZE14_1660TI_17

config MAINBOARD_SMBIOS_PRODUCT_NAME
	string
	default "Gazelle"

config MAINBOARD_VERSION
	string
	default "gaze14"

config CBFS_SIZE
	hex
	default 0xA00000

config MAINBOARD_PCI_SUBSYSTEM_VENDOR_ID
	hex
	default 0x1558

config MAINBOARD_PCI_SUBSYSTEM_DEVICE_ID
	hex
	default 0x8560 if BOARD_SYSTEM76_GAZE14_1650_15
	default 0x8561 if BOARD_SYSTEM76_GAZE14_1650_17
	default 0x8550 if BOARD_SYSTEM76_GAZE14_1660TI_15
	default 0x8551 if BOARD_SYSTEM76_GAZE14_1660TI_17

config CONSOLE_POST
	bool
	default y

config ONBOARD_VGA_IS_PRIMARY
	bool
	default y

config UART_FOR_CONSOLE
	int
	default 2

config MAX_CPUS
	int
	default 12

config DIMM_MAX
	int
	default 2

config DIMM_SPD_SIZE
	int
	default 512

# config VGA_BIOS_FILE
# 	string
# 	default "pci8086,3ea0.rom"

# config VGA_BIOS_ID
# 	string
# 	default "8086,3ea0"

config FSP_M_XIP
	bool
	default y

config POST_DEVICE
	bool
	default n

endif
```

## src/mainboard/system76/gaze14/Kconfig.name
```kconfig
config BOARD_SYSTEM76_GAZE14_1650
	bool "gaze14 1650"

config BOARD_SYSTEM76_GAZE14_1660TI
	bool "gaze14 1660Ti"
```

## src/mainboard/system76/gaze16/Kconfig.name
```kconfig
config BOARD_SYSTEM76_GAZE16_3050
	bool "gaze16 3050"

config BOARD_SYSTEM76_GAZE16_3060
	bool "gaze16 3060"
```

## src/mainboard/system76/gaze17/Kconfig
```kconfig
if BOARD_SYSTEM76_GAZE17_3050 || BOARD_SYSTEM76_GAZE17_3060_B

config BOARD_SPECIFIC_OPTIONS
	def_bool y
	select BOARD_ROMSIZE_KB_32768
	select DRIVERS_GFX_NVIDIA
	select DRIVERS_I2C_HID
	select EC_SYSTEM76_EC
	select EC_SYSTEM76_EC_COLOR_KEYBOARD
	select EC_SYSTEM76_EC_DGPU
	select HAVE_ACPI_TABLES
	select HAVE_CMOS_DEFAULT
	select HAVE_OPTION_TABLE
	select INTEL_GMA_HAVE_VBT
	select INTEL_LPSS_UART_FOR_CONSOLE
	select MAINBOARD_HAS_TPM2
	select MAINBOARD_USES_IFD_GBE_REGION if BOARD_SYSTEM76_GAZE17_3060_B
	select MEMORY_MAPPED_TPM
	select NO_UART_ON_SUPERIO
	select PCIEXP_HOTPLUG
	select PCIEXP_HOTPLUG_PREFETCH_MEM_BELOW_4G
	select SOC_INTEL_ALDERLAKE_PCH_P
	select SOC_INTEL_COMMON_BLOCK_HDA_VERB
	select SOC_INTEL_CRASHLOG
	select SPD_READ_BY_WORD
	select SYSTEM_TYPE_LAPTOP
	select TPM_MEASURED_BOOT
	select TPM_RDRESP_NEED_DELAY

config MAINBOARD_DIR
	default "system76/gaze17"

config MAINBOARD_PART_NUMBER
	default "gaze17-3050" if BOARD_SYSTEM76_GAZE17_3050
	default "gaze17-3060-b" if BOARD_SYSTEM76_GAZE17_3060_B

config MAINBOARD_SMBIOS_PRODUCT_NAME
	default "Gazelle"

config MAINBOARD_VERSION
	default "gaze17-3050" if BOARD_SYSTEM76_GAZE17_3050
	default "gaze17-3060-b" if BOARD_SYSTEM76_GAZE17_3060_B

config VARIANT_DIR
	default "3050" if BOARD_SYSTEM76_GAZE17_3050
	default "3060" if BOARD_SYSTEM76_GAZE17_3060_B

config OVERRIDE_DEVICETREE
	default "variants/\$(CONFIG_VARIANT_DIR)/overridetree.cb"

config CBFS_SIZE
	default 0xA00000

config CONSOLE_POST
	default y

config DIMM_SPD_SIZE
	default 512

config ONBOARD_VGA_IS_PRIMARY
	default y

config POST_DEVICE
	default n

config UART_FOR_CONSOLE
	default 0

# PM Timer Disabled, saves power
config USE_PM_ACPI_TIMER
	default n

endif
```

## src/mainboard/system76/gaze17/Kconfig.name
```kconfig
config BOARD_SYSTEM76_GAZE17_3050
	bool "gaze17 3050"

config BOARD_SYSTEM76_GAZE17_3060_B
	bool "gaze17 3060-b"
```

## src/mainboard/system76/kbl-u/Kconfig
```kconfig
if BOARD_SYSTEM76_GALP2 || BOARD_SYSTEM76_GALP3 || BOARD_SYSTEM76_GALP3_B

config BOARD_SPECIFIC_OPTIONS
	def_bool y
	select BOARD_ROMSIZE_KB_8192
	select HAVE_ACPI_RESUME
	select HAVE_ACPI_TABLES
	select INTEL_GMA_HAVE_VBT
	select INTEL_LPSS_UART_FOR_CONSOLE
	select MAINBOARD_HAS_LPC_TPM
	select MAINBOARD_HAS_TPM2
	select NO_UART_ON_SUPERIO
	select PCIEXP_HOTPLUG
	select SOC_INTEL_COMMON_BLOCK_HDA_VERB
	select SOC_INTEL_KABYLAKE
	select SPD_READ_BY_WORD
	select SYSTEM_TYPE_LAPTOP

config MAINBOARD_DIR
	string
	default "system76/kbl-u"

config VARIANT_DIR
	string
	default "galp2" if BOARD_SYSTEM76_GALP2
	default "galp3" if BOARD_SYSTEM76_GALP3
	default "galp3-b" if BOARD_SYSTEM76_GALP3_B

config MAINBOARD_PART_NUMBER
	string
	default "galp2" if BOARD_SYSTEM76_GALP2
	default "galp3" if BOARD_SYSTEM76_GALP3
	default "galp3-b" if BOARD_SYSTEM76_GALP3_B

config MAINBOARD_SMBIOS_PRODUCT_NAME
	string
	default "Galago Pro"

config MAINBOARD_VERSION
	string
	default "galp2" if BOARD_SYSTEM76_GALP2
	default "galp3" if BOARD_SYSTEM76_GALP3
	default "galp3-b" if BOARD_SYSTEM76_GALP3_B

config CBFS_SIZE
	hex
	default 0x600000

config CONSOLE_POST
	bool
	default y

config ONBOARD_VGA_IS_PRIMARY
	bool
	default y

config UART_FOR_CONSOLE
	int
	default 2

config MAX_CPUS
	int
	default 8

config DIMM_MAX
	int
	default 2

config DIMM_SPD_SIZE
	int
	default 512

config VGA_BIOS_ID
	string
	default "8086,5916" if BOARD_SYSTEM76_GALP2
	default "8086,5917" if BOARD_SYSTEM76_GALP3 || BOARD_SYSTEM76_GALP3_B

config POST_DEVICE
	bool
	default n

endif
```
