## src/mainboard/system76/serw12/Kconfig
```kconfig
# SPDX-License-Identifier: GPL-2.0-only

if BOARD_SYSTEM76_SERW12

config BOARD_SPECIFIC_OPTIONS
	def_bool y
	select SOC_AMD_COMMON_BLOCK_USE_ESPI
	select SOC_AMD_PICASSO
	select SOC_AMD_PICASSO_MATISSE
	select HAVE_ACPI_TABLES
	select BOARD_ROMSIZE_KB_16384
	select AZALIA_PLUGIN_SUPPORT
	select HAVE_ACPI_RESUME
	select EC_SYSTEM76_EC
	select EC_SYSTEM76_EC_COLOR_KEYBOARD
	select NO_UART_ON_SUPERIO
	select SPD_READ_BY_WORD
	select SYSTEM_TYPE_LAPTOP

config CBFS_SIZE
	hex
	default 0xFCF000

config MAINBOARD_DIR
	string
	default "system76/serw12"

config MAINBOARD_PART_NUMBER
	string
	default "serw12"

config MAINBOARD_SMBIOS_PRODUCT_NAME
	string
	default "Serval WS"

config MAINBOARD_VERSION
	string
	default "serw12"

config SUBSYSTEM_VENDOR_ID
	hex
	default 0x1558

#TODO
config SUBSYSTEM_DEVICE_ID
	hex
	default 0x0000

config MAX_CPUS
	int
	default 16

config DIMM_MAX
	int
	default 2

config DIMM_SPD_SIZE
	int
	default 512

config CONSOLE_POST
	bool
	default y

config POST_DEVICE
	bool
	default n

endif
```

## src/mainboard/system76/thelio-b1/Kconfig
```kconfig
if BOARD_SYSTEM76_THELIO_B1

config BOARD_SPECIFIC_OPTIONS
	def_bool y
	select ADD_FSP_BINARIES
	select BOARD_ROMSIZE_KB_16384
	select EC_ACPI
	select EXCLUDE_EMMC_INTERFACE
	select FSP_USE_REPO
	select HAVE_ACPI_RESUME
	select HAVE_ACPI_TABLES
	select HAVE_SMI_HANDLER
	select INTEL_GMA_HAVE_VBT
	select MAINBOARD_HAS_LPC_TPM
	select MAINBOARD_HAS_TPM2
	select MAINBOARD_USES_IFD_GBE_REGION
	select SOC_INTEL_CANNONLAKE_PCH_H
	select SOC_INTEL_COFFEELAKE
	select SOC_INTEL_COMMON_BLOCK_HDA
	select SOC_INTEL_COMMON_BLOCK_HDA_VERB
	select SPD_READ_BY_WORD
	select SYSTEM_TYPE_DESKTOP
	select USE_BLOBS

config MAINBOARD_DIR
	string
	default system76/thelio-b1

config MAINBOARD_PART_NUMBER
	string
	default "thelio-b1"

config CBFS_SIZE
	hex
	default 0xA00000

config MAINBOARD_PCI_SUBSYSTEM_VENDOR_ID
	hex
	default 0x1458

config MAINBOARD_PCI_SUBSYSTEM_DEVICE_ID
	hex
	default 0xa0c3

config CONSOLE_POST
	bool
	default y

config ONBOARD_VGA_IS_PRIMARY
	bool
	default y

config MAX_CPUS
	int
	default 16

config DIMM_MAX
	int
	default 2

config DIMM_SPD_SIZE
	int
	default 512

config VGA_BIOS_FILE
	string
	default "pci8086,3e98.rom"

config VGA_BIOS_ID
	string
	default "8086,3e98"

config PXE_ROM_ID
	string
	default "8086,1539"

config FSP_M_XIP
	bool
	default y

config POST_DEVICE
	bool
	default n

endif
```

## src/mainboard/system76/whl-u/Kconfig
```kconfig
if BOARD_SYSTEM76_GALP3_C || BOARD_SYSTEM76_DARP5

config BOARD_SPECIFIC_OPTIONS
	def_bool y
	select BOARD_ROMSIZE_KB_16384
	select DRIVERS_I2C_HID
	select EC_SYSTEM76_EC
	select EC_SYSTEM76_EC_COLOR_KEYBOARD if BOARD_SYSTEM76_DARP5
	select HAVE_ACPI_RESUME
	select HAVE_ACPI_TABLES
	select HAVE_CMOS_DEFAULT
	select HAVE_OPTION_TABLE
	select HAVE_SMI_HANDLER
	select INTEL_GMA_HAVE_VBT
	select INTEL_LPSS_UART_FOR_CONSOLE
	select MAINBOARD_HAS_LPC_TPM
	select MAINBOARD_HAS_TPM2
	select NO_UART_ON_SUPERIO
	select PCIEXP_HOTPLUG
	select SOC_INTEL_COMMON_ACPI_EC_PTS_WAK
	select SOC_INTEL_COMMON_BLOCK_HDA
	select SOC_INTEL_COMMON_BLOCK_HDA_VERB
	select SOC_INTEL_WHISKEYLAKE
	select SPD_READ_BY_WORD
	select SYSTEM_TYPE_LAPTOP
	select TPM_RDRESP_NEED_DELAY
	select USE_OPTION_TABLE
	select USE_LEGACY_8254_TIMER # Fix failure to boot GRUB

config MAINBOARD_DIR
	string
	default "system76/whl-u"

config VARIANT_DIR
	string
	default "galp3-c" if BOARD_SYSTEM76_GALP3_C
	default "darp5" if BOARD_SYSTEM76_DARP5

config OVERRIDE_DEVICETREE
	string
	default "variants/$(CONFIG_VARIANT_DIR)/overridetree.cb"

config MAINBOARD_PART_NUMBER
	string
	default "galp3-c" if BOARD_SYSTEM76_GALP3_C
	default "darp5" if BOARD_SYSTEM76_DARP5

config CBFS_SIZE
	hex
	default 0xA00000

config SUBSYSTEM_VENDOR_ID
	hex
	default 0x1558

config SUBSYSTEM_DEVICE_ID
	hex
	default 0x1323 if BOARD_SYSTEM76_GALP3_C
	default 0x1325 if BOARD_SYSTEM76_DARP5

config CONSOLE_POST
	bool
	default y

config ONBOARD_VGA_IS_PRIMARY
	bool
	default y

config UART_FOR_CONSOLE
	int
	default 2

config MAX_CPUS
	int
	default 8

config DIMM_MAX
	int
	default 2

config DIMM_SPD_SIZE
	int
	default 512

config VGA_BIOS_FILE
	string
	default "pci8086,3ea0.rom"

config VGA_BIOS_ID
	string
	default "8086,3ea0"

config PXE_ROM_ID
	string
	default "10ec,8168"

config FSP_M_XIP
	bool
	default y

config POST_DEVICE
	bool
	default n

endif
```

## src/security/tcg/Kconfig
```kconfig
# SPDX-License-Identifier: GPL-2.0-only

menu "TCG storage"

source "src/security/tcg/opal_s3/Kconfig"

endmenu
```

## src/security/tcg/opal_s3/Kconfig
```kconfig
# SPDX-License-Identifier: GPL-2.0-only

config TCG_OPAL_S3_UNLOCK
	bool "SMM-assisted OPAL NVMe unlock on S3 resume"
	depends on ARCH_X86
	depends on HAVE_SMI_HANDLER
	depends on HAVE_ACPI_RESUME
	depends on PCI
	select SMM_OPAL_S3_SCRATCH_CBMEM
	select SMM_OPAL_S3_STATE_SMRAM
	help
	  Provide an SMM handler that accepts an OPAL password for the current
	  sleep cycle and performs an NVMe Security Send/Receive unlock on S3
	  resume.

	  This is intended to be used by payloads which prompt the user for the
	  OPAL password and pass it to SMM before entering S3.
```

## src/soc/amd/common/block/pci/Kconfig
```kconfig
## SPDX-License-Identifier: GPL-2.0-only

config SOC_AMD_COMMON_BLOCK_PCI
	bool
	select SOC_AMD_COMMON_BLOCK_PCI_MMCONF
	help
	  This option builds functions used to program PCI interrupt
	  routing, both PIC and APIC modes.

config SOC_AMD_COMMON_BLOCK_PCI_MMCONF
	bool
	help
	  Selecting this option adds the AMD-common enable_pci_mmconf function
	  to the build.

config SOC_AMD_COMMON_BLOCK_PCIE_GPP_DRIVER
	bool
	depends on SOC_AMD_COMMON_BLOCK_PCI
	help
	  Select this option to use AMD common PCIe GPP driver.

config SOC_AMD_COMMON_BLOCK_PCI_DOMAIN_ROOT_PRT
	bool
	depends on SOC_AMD_COMMON_BLOCK_PCI
	depends on HAVE_ACPI_TABLES
	help
	  After pci_domain_fill_ssdt(), emit Method(_PRT) on the PCI host bridge
	  scope for root-bus devices (e.g. PCIe root ports) using
	  get_pci_routing_table(). Needed when the SoC ACPI sources do not supply
	  PCI0._PRT.
```

## src/soc/intel/novalake/Kconfig
```kconfig
## SPDX-License-Identifier: GPL-2.0-only

config SOC_INTEL_NOVALAKE_BASE
	bool
	select ACPI_INTEL_HARDWARE_SLEEP_VALUES
	select ARCH_ALL_STAGES_X86_64
	select ARCH_X86
	select BOOT_DEVICE_SUPPORTS_WRITES
	select CACHE_MRC_SETTINGS
	select CBFS_PRELOAD
	select COOP_MULTITASKING
	select CPU_INTEL_COMMON
	select CPU_INTEL_COMMON_VOLTAGE
	select CPU_INTEL_FIRMWARE_INTERFACE_TABLE
	select CPU_SUPPORTS_PM_TIMER_EMULATION
	select DEFAULT_SOFTWARE_CONNECTION_MANAGER if MAINBOARD_HAS_CHROMEOS
	select DEFAULT_X2APIC_RUNTIME
	select DISPLAY_FSP_VERSION_INFO_2
	select DRAM_SUPPORT_DDR5
	select FAST_SPI_DMA
	select FAST_SPI_SUPPORTS_EXT_BIOS_WINDOW
	select FSP_DIMM_INFO
	select FSP_M_XIP
	select FSP_USES_CB_DEBUG_EVENT_HANDLER
	select HAVE_DEBUG_RAM_SETUP
	select HAVE_FSP_GOP
	select HAVE_X86_64_SUPPORT
	select IDT_IN_EVERY_STAGE
	select INTEL_DESCRIPTOR_MODE_CAPABLE
	select INTEL_GMA_ADD_VBT if RUN_FSP_GOP
	select IOAPIC
	select MICROCODE_BLOB_UNDISCLOSED
	select MRC_CACHE_USING_MRC_VERSION
	select MRC_SETTINGS_PROTECT
	select PCIE_CLOCK_CONTROL_THROUGH_P2SB
	select PLATFORM_USES_FSP2_4
	select POSTPONE_SPI_ACCESS
	select SOC_INTEL_COMMON
	select SOC_INTEL_COMMON_BASECODE
	select SOC_INTEL_COMMON_BASECODE_RAMTOP
	select SOC_INTEL_COMMON_BLOCK
	select SOC_INTEL_COMMON_BLOCK_CAR
	select SOC_INTEL_COMMON_BLOCK_CAR_ENHANCED_NEM
	select SOC_INTEL_COMMON_BLOCK_CHIP_CONFIG
	select SOC_INTEL_COMMON_BLOCK_CPU
	select SOC_INTEL_COMMON_BLOCK_GSPI_VERSION_2
	select SOC_INTEL_COMMON_BLOCK_MEMINIT
	select SOC_INTEL_COMMON_BLOCK_P2SB2
	select SOC_INTEL_COMMON_BLOCK_SA
	select SOC_INTEL_COMMON_FEATURE
	select SOC_INTEL_COMMON_FEATURE_ESPI
	select SOC_INTEL_COMMON_FEATURE_GSPI_DEVFN
	select SOC_INTEL_COMMON_FEATURE_I2C_DEVFN
	select SOC_INTEL_COMMON_FEATURE_LOCKDOWN
	select SOC_INTEL_COMMON_FEATURE_PMUTIL
	select SOC_INTEL_COMMON_FEATURE_SPI_DEVFN
	select SOC_INTEL_COMMON_FEATURE_SPI_DEVFN_PSF
	select SOC_INTEL_COMMON_FEATURE_UART_DEVICES
	select SOC_INTEL_COMMON_PCH_CLIENT
	select SOC_INTEL_COMMON_RESET
	select SSE2
	select SUPPORT_CPU_UCODE_IN_CBFS
	select TSC_MONOTONIC_TIMER
	select UDELAY_TSC
	select UDK_202302_BINDING
	select USE_X86_64_SUPPORT
	help
	  Intel Nova Lake support. Mainboards should specify the SoC
	  type using the `SOC_INTEL_NOVALAKE_*` options instead
	  of selecting this option directly.

config SOC_INTEL_NOVALAKE
	bool
	select SOC_INTEL_NOVALAKE_BASE
	help
	  Intel Nova Lake SoC. This should be selected by all Nova Lake SoC variants.

config SOC_INTEL_NOVALAKE_H_P
	bool
	select SOC_INTEL_NOVALAKE
	help
	  Choose this option if the mainboard is built using either a NVL-H or
	  NVL-P system-on-a-chip SoC.

if SOC_INTEL_NOVALAKE_BASE

config SOC_INTEL_NOVALAKE_TCSS_USB4_SUPPORT
	bool
	default y
	select SOC_INTEL_COMMON_BLOCK_TCSS
	select SOC_INTEL_COMMON_BLOCK_USB4
	select SOC_INTEL_COMMON_BLOCK_USB4_PCIE
	select SOC_INTEL_COMMON_BLOCK_USB4_XHCI

config MAX_CPUS
	int
	default 28

config DCACHE_RAM_BASE
	default 0xfc200000  # NVL unused area 5MB

config DCACHE_RAM_SIZE
	default 0x200000
	help
	  The size of the cache-as-ram region required during bootblock
	  and/or romstage.

config DCACHE_BSP_STACK_SIZE
	hex
	default 0x88000
	help
	  The amount of anticipated stack usage in CAR by bootblock and
	  other stages. In the case of FSP_USES_CB_STACK default value will be
	  sum of FSP-M stack requirement(512KiB) and CB romstage stack requirement
	  (~32KiB).

config FSP_TEMP_RAM_SIZE
	hex
	default 0x80100
	help
	  The amount of anticipated heap usage in CAR by FSP.
	  Refer to Platform FSP integration guide document to know
	  the exact FSP requirement for Heap setup.

config HEAP_SIZE
	hex
	default 0x10000

config CHIPSET_DEVICETREE
	string
	default "soc/intel/novalake/chipset.cb"

config EXT_BIOS_WIN_BASE
	default 0xf8000000

config EXT_BIOS_WIN_SIZE
	default 0x2000000

config IFD_CHIPSET
	string
	default "ifd2"

config IED_REGION_SIZE
	hex
	default 0x400000

# Intel recommends reserving the PCIe TBT root port resources as below:
# - 42 buses
# - 194 MiB Non-prefetchable memory
# - 448 MiB Prefetchable memory
if SOC_INTEL_ENABLE_USB4_PCIE_RESOURCES

config PCIEXP_HOTPLUG_BUSES
	int
	default 42

config PCIEXP_HOTPLUG_MEM
	hex
	default 0xc200000

config PCIEXP_HOTPLUG_PREFETCH_MEM
	hex
	default 0x1c000000

endif # SOC_INTEL_ENABLE_USB4_PCIE_RESOURCES

config MAX_TBT_ROOT_PORTS
	int
	default 3

config MAX_TCSS_PORTS
	int
	default 3

config MAX_ROOT_PORTS
	int
	default 14

config MAX_PCIE_CLOCK_SRC
	int
	default 9

config SMM_TSEG_SIZE
	hex
	default 0x2000000

config SMM_RESERVED_SIZE
	hex
	default 0x200000

config PCR_BASE_ADDRESS
	hex
	default 0x4100000000
	help
	  This option allows you to select MMIO Base Address of P2SB#1 aka SoC P2SB.

config P2SB_2_PCR_BASE_ADDRESS
	hex
	default 0x4110000000
	help
	  This option allows you to select MMIO Base Address of P2SB#2 aka SoC P2SB2.

config ECAM_MMCONF_BASE_ADDRESS
	default 0xE0000000

config CPU_BCLK_MHZ
	int
	default 100

config SOC_INTEL_COMMON_BLOCK_GSPI_CLOCK_MHZ
	int
	default 120

config CPU_XTAL_HZ
	default 38400000

config DRIVERS_I2C_DESIGNWARE_CLOCK_MHZ
	int
	default 133

config SOC_INTEL_COMMON_BLOCK_GSPI_MAX
	int
	default 2

config SOC_INTEL_SPI_DEV_MAX
	int
	default 2

config SOC_INTEL_SPI_PSF_DESTINATION_ID
	hex
	default 0x5140

config SOC_INTEL_I2C_DEV_MAX
	int
	default 6

config SOC_INTEL_I3C_DEV_MAX
	int
	default 2

config SOC_INTEL_UART_DEV_MAX
	int
	default 3

config SOC_INTEL_USB2_DEV_MAX
	int
	default 8

config SOC_INTEL_USB3_DEV_MAX
	int
	default 2

config CONSOLE_UART_BASE_ADDRESS
	hex
	default 0xFE02C000
	depends on INTEL_LPSS_UART_FOR_CONSOLE

config VBT_DATA_SIZE_KB
	int
	default 9

# Clock divider parameters for 115200 baud rate
# Baudrate = (UART source clock * M) /(N *16)
# NVL UART source clock: 100MHz
config SOC_INTEL_COMMON_LPSS_UART_CLK_M_VAL
	hex
	default 0x25a

config SOC_INTEL_COMMON_LPSS_UART_CLK_N_VAL
	hex
	default 0x7fff

config VBOOT
	select VBOOT_MUST_REQUEST_DISPLAY
	select VBOOT_SEPARATE_VERSTAGE
	select VBOOT_STARTS_IN_BOOTBLOCK
	select VBOOT_VBNV_CMOS
	select VBOOT_VBNV_CMOS_BACKUP_TO_FLASH
	select VBOOT_X86_RSA_ACCELERATION
	select VBOOT_X86_SHA256_ACCELERATION

# Default hash block size is 1KiB. Increasing it to 4KiB to improve
# hashing time as well as read time.
config VBOOT_HASH_BLOCK_SIZE
	hex
	default 0x1000

config CBFS_SIZE
	hex
	default 0x200000

config CBFS_MCACHE_SIZE
	hex
	default 0x8000

config PRERAM_CBMEM_CONSOLE_SIZE
	hex
	default 0x40000 if BUILDING_WITH_DEBUG_FSP
	default 0x2000

config CONSOLE_CBMEM_BUFFER_SIZE
	hex
	default 0x100000 if BUILDING_WITH_DEBUG_FSP
	default 0x40000

config FSP_HEADER_PATH
	string "Location of FSP headers"
	default "src/vendorcode/intel/fsp/fsp2_0/novalake/"

# Override platform debug consent value:
#  0: Disabled,
#  2: Enabled Trace active: TraceHub is enabled and trace is active, blocks s0ix,
#  4: Enabled Trace ready: TraceHub is enabled and allowed S0ix,
#  6: Enabled Trace power off: TraceHub is powergated, provide setting close to functional
#    low power state,
#  7: User needs to configure Advanced Debug Settings manually.
config SOC_INTEL_COMMON_DEBUG_CONSENT
	int
	default 4 if SOC_INTEL_DEBUG_CONSENT

config DATA_BUS_WIDTH
	int
	default 128

config DIMMS_PER_CHANNEL
	int
	default 2

config DIMM_MAX
	default 16

config MRC_CHANNEL_WIDTH
	int
	default 16

config SOC_INTEL_GFX_FRAMEBUFFER_OFFSET
	hex
	default 0x800000

config DROP_CPU_FEATURE_PROGRAM_IN_FSP
	bool
	default y if MP_SERVICES_PPI_V2_NOOP || CHROMEOS
	default n
	help
	  This is to avoid FSP running basic CPU feature programming on BSP
	  and on APs using the "CpuFeaturesPei.efi" module. The feature programming
	  includes enabling x2APIC, MCA, MCE and Turbo etc.

	  Most of these feature programming are getting performed today in scope
	  of coreboot doing MP Init. Running these redundant programming in scope
	  of FSP (when `USE_FSP_FEATURE_PROGRAM_ON_APS` config is enabled) would
	  results in CPU exception.

	  SoC users to select this config after dropping "CpuFeaturesPei.ffs" module
	  from FSP-S Firmware Volume (FV). Upon selection, coreboot runs those additional
	  feature programming on BSP and APs.

	  This feature is default enabled, in case of "coreboot running MP init"
	  aka MP_SERVICES_PPI_V2_NOOP config is selected.

config PCIE_LTR_MAX_SNOOP_LATENCY
	hex
	default 0x100f
	help
	  Latency tolerance reporting, max snoop latency value defaults to 15.73 ms.

config PCIE_LTR_MAX_NO_SNOOP_LATENCY
	hex
	default 0x100f
	help
	  Latency tolerance reporting, max non-snoop latency value defaults to 15.73 ms.

config SOC_PHYSICAL_ADDRESS_WIDTH
	int
	default 42

# Override DEBUG Kconfig to avoid false alarm about stack overflow.
config DEBUG_STACK_OVERFLOW_BREAKPOINTS
	bool
	default n

config DEBUG_STACK_OVERFLOW_BREAKPOINTS_IN_ALL_STAGES
	bool
	default n

# Fast SPI DMA operations require 1 KiB-aligned memory buffers.
config CBFS_CACHE_ALIGN
	default 1024

endif
```
