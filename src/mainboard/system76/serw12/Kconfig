## src/soc/qualcomm/calypso/Kconfig
```kconfig
## SPDX-License-Identifier: GPL-2.0-only

config SOC_QUALCOMM_CALYPSO_BASE
	bool
	default n
	select ARCH_BOOTBLOCK_ARMV8_64
	select ARCH_RAMSTAGE_ARMV8_64
	select ARCH_ROMSTAGE_ARMV8_64
	select ARCH_VERSTAGE_ARMV8_64
	select ARM64_USE_ARCH_TIMER
	select CACHE_MRC_SETTINGS
	select COMMONLIB_STORAGE
	select COMMONLIB_STORAGE_SD
	select FIXED_UART_FOR_CONSOLE
	select GENERIC_GPIO_LIB
	select GENERIC_UDELAY
	select HAS_RECOVERY_MRC_CACHE
	select HAVE_CBFS_FILE_OPTION_BACKEND
	select HAVE_LINEAR_FRAMEBUFFER
	select HAVE_MONOTONIC_TIMER
	select HAVE_UART_SPECIAL
	select MAINBOARD_FORCE_NATIVE_VGA_INIT
	select MAINBOARD_HAS_NATIVE_VGA_INIT
	select NO_ECAM_MMCONF_SUPPORT
	select PCI
	select SOC_QUALCOMM_COMMON
	select SOC_QUALCOMM_QCLIB_SKIP_MMU_TOGGLE

config SOC_QUALCOMM_CALYPSO
	bool
	select SOC_QUALCOMM_CALYPSO_BASE
	default n
	help
	  Choose this option if the mainboard is built using Calypso system-on-a-chip SoC.

if SOC_QUALCOMM_CALYPSO_BASE

config QC_BLOBS_UPSTREAM
	bool "QC blobs are available in upstream repository"
	select USE_QC_BLOBS
	default n
	help
	  Select based on availability of QC blobs in upstream coreboot `3rdparty/qc_blobs`.

config MEMLAYOUT_LD_FILE
	string
	default "src/soc/qualcomm/calypso/memlayout.ld"

config VBOOT
	select VBOOT_MUST_REQUEST_DISPLAY
	select VBOOT_RETURN_FROM_VERSTAGE
	select VBOOT_SEPARATE_VERSTAGE
	select VBOOT_STARTS_IN_BOOTBLOCK

config BOOT_DEVICE_SPI_FLASH_BUS
	int
	default 26

config UART_FOR_CONSOLE
	int
	default 21 # QUP2_SE5
	help
	 Select the QUP instance to be used for UART console output.

config UART_BITBANG_TX_DELAY_MS
	int
	default 1

endif
```

## src/soc/qualcomm/common/Kconfig
```kconfig
## SPDX-License-Identifier: GPL-2.0-only

config SOC_QUALCOMM_COMMON
	bool
	default n
	help
	  Selected by platforms that use the common code.

config QC_COMMON_QUPV3_2
	bool
	default n
	help
	  Selected by chipsets that has QUPv3 HW Version 2.

config QMP_PHY_2X2_1X4
	bool
	default n
	help
	  Selected by chipsets that have PCIE QMP PHY 2X2/1X4

if SOC_QUALCOMM_COMMON

config QC_SDI_ENABLE
	bool
	default n
	prompt "Debug Build: enable SDI"

config QC_APDP_ENABLE
	bool
	default n
	prompt "Debug Build: enable APDP"
	help
	  Application Processor Debug Policy (APDP) is a configuration image
	  to define and enforce debugging capabilities and restrictions for APPS.

config QC_RAMDUMP_ENABLE
	bool
	default n
	prompt "Debug Build: enable Ramdump"
	help
	  Ramdump is a debug image that is loaded during a system crash to capture
	  memory contents for post-crash analysis.

config SOC_QUALCOMM_QCLIB_SKIP_MMU_TOGGLE
	bool
	default n
	help
	  Avoid disabling and re-enabling the MMU during QCLib execution.

	  Select this option if the platform's QCLib version supports running
	  within the existing coreboot MMU configuration without modification.

	  Enabling this reduces boot latency by eliminating redundant cache
	  flushes and TLB invalidations associated with mmu_disable() and
	  mmu_enable() calls.

config SOC_QUALCOMM_DEBUG_TSENS
	bool
	default n
	help
	  When enabled, a call to monitor TSENS will dump the sensor data on
	  the debug console.

config SOC_QUALCOMM_PCIE_ASYNCHRONOUS_INIT
	bool
	default n
	help
	  When enabled, qcom_setup_pcie_host will initiate the PCIe
	  hardware power-up sequence but will not block the boot flow
	  to wait for the link-up status. This can reduce overall
	  boot time, but requires late-stage drivers to verify link
	  readiness before access.

config QC_DUMP_MEMCHIP_INFO
	bool
	default n
	help
	  When enabled, coreboot will print detailed memory chip attributes
	  to the console during the boot process. This includes
	  Manufacturer IDs, Revision IDs, and Serial IDs for each rank.

	  Note: Enabling this feature increases the size of the romstage
	  binary. If your platform is near its ROM size limit, this may
	  cause a build failure. Only enable this for memory bring-up or
	  debugging.

endif
```
