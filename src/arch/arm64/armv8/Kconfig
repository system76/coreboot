## src/arch/arm64/armv8/Kconfig
```kconfig
## SPDX-License-Identifier: GPL-2.0-only

config ARCH_BOOTBLOCK_ARMV8_64
	bool
	select ARCH_BOOTBLOCK_ARM64

config ARCH_VERSTAGE_ARMV8_64
	bool
	select ARCH_VERSTAGE_ARM64

config ARCH_ROMSTAGE_ARMV8_64
	bool
	select ARCH_ROMSTAGE_ARM64

config ARCH_RAMSTAGE_ARMV8_64
	bool
	select ARCH_RAMSTAGE_ARM64

if ARCH_ARM64

config ARCH_ARMV8_EXTENSION
	int
	default 0
	help
	  Specify ARMv8 extension, for example '1' for ARMv8.1, to control the
	  '-march' option passed into the compiler. Defaults to 0 for vanilla
	  ARMv8 but may be overridden in the SoC's Kconfig.

	  All ARMv8 implementations are downwards-compatible, so this does not
	  need to be changed unless specific features (e.g. new instructions)
	  are used by the SoC's coreboot code.

config ARCH_ARM64_DEBUG_MMU
	bool "Debug MMU table"
	default n
	help
	  When enabled, the MMU table walker will dump the translation
	  table entries and their attributes to the debug console during
	  initialization or range configuration.

	  This is useful for verifying that memory ranges (Normal, Device,
	  Read-Only, etc.) are being mapped correctly in the page tables.

endif # ARCH_ARM64
```

## src/drivers/gfx/nvidia/Kconfig
```kconfig
config DRIVERS_GFX_NVIDIA
	bool
	default n
	help
	  Support for NVIDIA Optimus graphics

config DRIVERS_GFX_NVIDIA_BRIDGE
	hex "PCI bridge for the GPU device"
	default 0x01
	depends on DRIVERS_GFX_NVIDIA

config DRIVERS_GFX_NVIDIA_DYNAMIC_BOOST
	depends on DRIVERS_GFX_NVIDIA
	bool
	default n
	help
	  Support for NVIDIA Dynamic Boost

config DRIVERS_GFX_NVIDIA_DYNAMIC_BOOST_TPP
	int "Total processor power offset from default TGP in watts"
	default 45
	depends on DRIVERS_GFX_NVIDIA_DYNAMIC_BOOST
	help
	  This identifies the available power for the CPU or GPU boost

config DRIVERS_GFX_NVIDIA_DYNAMIC_BOOST_MIN
	int "Minimum TGP offset from default TGP in watts"
	default 0
	depends on DRIVERS_GFX_NVIDIA_DYNAMIC_BOOST
	help
	  This is used to transfer power from the GPU to the CPU

config DRIVERS_GFX_NVIDIA_DYNAMIC_BOOST_MAX
	int "Maximum TGP offset from default TGP in watts"
	default 0
	depends on DRIVERS_GFX_NVIDIA_DYNAMIC_BOOST
	help
	  This is used to transfer power from the CPU to the GPU
```

## src/drivers/intel/dtbt/Kconfig
```kconfig
config DRIVERS_INTEL_DTBT
	def_bool n
	help
	  Support for discrete Thunderbolt controllers
```

## src/drivers/intel/oc_mailbox/Kconfig
```kconfig
## SPDX-License-Identifier: GPL-2.0-only

config DRIVERS_INTEL_OC_MAILBOX
	bool
	help
	  Provides access to the Intel's OC Mailbox MSR (0x150).
	  Supports 4th-10th generation Intel Core CPUs (Haswell-Cometlake).

if DRIVERS_INTEL_OC_MAILBOX

config INTEL_OC_MAILBOX_ENABLE_UNDERVOLTING
	bool "Enable undervolting via OC mailbox"
	help
	  Program per-plane voltage offsets via OC Mailbox MSR.
	  When enabled, coreboot can apply per-domain undervolt settings at boot
	  (core/GT/cache/SA and I/O planes, depending on CPU generation). Settings
	  are exposed as runtime options and written using OC_MAILBOX commands.

config HAS_DIGITAL_IO_POWER_DOMAIN
	bool
	default n

endif
```

## src/drivers/system76/dgpu/Kconfig
```kconfig
config DRIVERS_SYSTEM76_DGPU
	bool
	default n
	help
		System76 switchable graphics support

#TODO: make this cleaner, use device tree?
config DRIVERS_SYSTEM76_DGPU_DEVICE
	hex
	default 0x01
	help
		System76 switchable graphics root device number

config DRIVERS_SYSTEM76_DGPU_FUNCTION
	hex
	default 0x00
	help
		System76 switchable graphics root device number
```

## src/mainboard/asus/h610m-k/Kconfig
```kconfig
## SPDX-License-Identifier: GPL-2.0-only

config BOARD_ASUS_H610M_K
	select BOARD_ROMSIZE_KB_16384
	select HAVE_ACPI_RESUME
	select HAVE_ACPI_TABLES
	select INTEL_GMA_HAVE_VBT
	select SOC_INTEL_ALDERLAKE_PCH_S
	select SOC_INTEL_COMMON_BLOCK_HDA_VERB
	select SUPERIO_NUVOTON_COMMON_COM_A
	select SUPERIO_NUVOTON_COMMON_HWM
	select SUPERIO_NUVOTON_NCT6791D
	select USE_LEGACY_8254_TIMER

if BOARD_ASUS_H610M_K

config MAINBOARD_DIR
	default "asus/h610m-k"

config MAINBOARD_PART_NUMBER
	default "ASUS PRIME H610M-K D4"

config UART_FOR_CONSOLE
	int
	default 0

config USE_PM_ACPI_TIMER
	bool
	default n

config CBFS_SIZE
	hex
	default 0xb00000

endif
```

## src/mainboard/asus/h610m-k/Kconfig.name
```kconfig
## SPDX-License-Identifier: GPL-2.0-only

config BOARD_ASUS_H610M_K
	bool "PRIME H610M-K D4"
```

## src/mainboard/asus/h81m_k/Kconfig.name
```kconfig
## SPDX-License-Identifier: GPL-2.0-only

config BOARD_ASUS_H81M_K
	bool "H81M-K"
```

## src/mainboard/asus/maximus_vi_formula/Kconfig.name
```kconfig
## SPDX-License-Identifier: GPL-2.0-only

config BOARD_ASUS_MAXIMUS_VI_FORMULA
	bool "Maximus VI FORMULA"
```

## src/mainboard/asus/maximus_vii_ranger/Kconfig.name
```kconfig
## SPDX-License-Identifier: GPL-2.0-only

config BOARD_ASUS_MAXIMUS_VII_RANGER
	bool "Maximus VII RANGER"
```

## src/mainboard/google/atria/Kconfig
```kconfig
## SPDX-License-Identifier: GPL-2.0-only

config BOARD_GOOGLE_ATRIA_COMMON
	def_bool n
	select BOARD_ROMSIZE_KB_32768
	select CPU_INTEL_SOCKET_OTHER
	select DUMP_SMBIOS_TYPE17
	select EC_ACPI
	select EC_GOOGLE_CHROMEEC
	select EC_GOOGLE_CHROMEEC_BOARDID
	select EC_GOOGLE_CHROMEEC_ESPI
	select EC_GOOGLE_CHROMEEC_SKUID
	select EC_GOOGLE_CHROMEEC_SMBIOS
	select GENERATE_SMBIOS_TABLES
	select GOOGLE_SMBIOS_MAINBOARD_VERSION
	select HAVE_ACPI_TABLES
	select HAVE_SPD_IN_CBFS
	select INTEL_LPSS_UART_FOR_CONSOLE
	select MAINBOARD_DISABLE_STAGE_CACHE
	select MB_COMPRESS_RAMSTAGE_LZ4
	select SOC_INTEL_PANTHERLAKE_U_H

config BOARD_GOOGLE_BASEBOARD_ATRIA
	def_bool n
	select BOARD_GOOGLE_ATRIA_COMMON
	select SYSTEM_TYPE_LAPTOP

config BOARD_GOOGLE_ATRIA
	select BOARD_GOOGLE_BASEBOARD_ATRIA
	select EC_GOOGLE_CHROMEEC_RTK
	select EC_GOOGLE_CHROMEEC_LPC_GENERIC_MEMORY_RANGE

if BOARD_GOOGLE_ATRIA_COMMON

config BASEBOARD_DIR
	string
	default "atria"

config CBFS_SIZE
	default 0x1000000

config DEVICETREE
	default "variants/baseboard/devicetree.cb"

config DIMM_SPD_SIZE
	default 512

config MAINBOARD_DIR
	default "google/atria"

config MAINBOARD_FAMILY
	string
	default "Google_Atria"

config MAINBOARD_PART_NUMBER
	default "Atria" if BOARD_GOOGLE_ATRIA

config VARIANT_DIR
	string
	default "atria" if BOARD_GOOGLE_ATRIA

config OVERRIDE_DEVICETREE
	default "variants/\$(CONFIG_VARIANT_DIR)/overridetree.cb"

config UART_FOR_CONSOLE
	int
	default 0

endif # BOARD_GOOGLE_ATRIA_COMMON
```

## src/mainboard/google/atria/Kconfig.name
```kconfig
## SPDX-License-Identifier: GPL-2.0-only

comment "Atria (Intel PantherLake)"

config BOARD_GOOGLE_ATRIA
	bool "->  Atria"
```

## src/mainboard/google/calypso/Kconfig.name
```kconfig
## SPDX-License-Identifier: GPL-2.0-only

comment "Calypso (Qualcomm Calypso)"

config BOARD_GOOGLE_MENSA
	bool "->  Mensa"
```

## src/mainboard/google/mensa/Kconfig.name
```kconfig
## SPDX-License-Identifier: GPL-2.0-only

comment "Mensa (Qualcomm Calypso)"

config BOARD_GOOGLE_MENSA
	bool "->  Mensa"
```

## src/mainboard/starlabs/cezanne/Kconfig.name
```kconfig
## SPDX-License-Identifier: GPL-2.0-only

comment "Star Labs StarBook Series"

config BOARD_STARLABS_STARBOOK_CEZANNE
	bool "Star Labs StarBook Mk VI (Ryzen 7 5800U)"
```

## src/mainboard/system76/addw2/Kconfig
```kconfig
if BOARD_SYSTEM76_ADDW2

config BOARD_SPECIFIC_OPTIONS
	def_bool y
	select BOARD_ROMSIZE_KB_16384
	select DRIVERS_I2C_HID
	select DRIVERS_I2C_TAS5825M
	select DRIVERS_SYSTEM76_DGPU
	select EC_SYSTEM76_EC
	select EC_SYSTEM76_EC_COLOR_KEYBOARD
	select EC_SYSTEM76_EC_DGPU
	select EC_SYSTEM76_EC_OLED
	select HAVE_ACPI_RESUME
	select HAVE_ACPI_TABLES
	select HAVE_SMI_HANDLER
	select INTEL_GMA_HAVE_VBT
	select INTEL_LPSS_UART_FOR_CONSOLE
	select MAINBOARD_HAS_LPC_TPM
	select MAINBOARD_HAS_TPM2
	select NO_UART_ON_SUPERIO
	select PCIEXP_HOTPLUG
	select SOC_INTEL_CANNONLAKE_PCH_H
	select SOC_INTEL_COMETLAKE
	select SOC_INTEL_COMMON_BLOCK_HDA
	select SOC_INTEL_COMMON_BLOCK_HDA_VERB
	select SPD_READ_BY_WORD
	select SYSTEM_TYPE_LAPTOP
	select TPM_RDRESP_NEED_DELAY	
	select USE_LEGACY_8254_TIMER # Fix failure to boot GRUB

config MAINBOARD_DIR
	string
	default "system76/addw2"

config MAINBOARD_PART_NUMBER
	string
	default "addw2"

config MAINBOARD_SMBIOS_PRODUCT_NAME
	string
	default "Adder WS"

config MAINBOARD_VERSION
	string
	default "addw2"

config CBFS_SIZE
	hex
	default 0xA00000

config SUBSYSTEM_VENDOR_ID
	hex
	default 0x1558

config SUBSYSTEM_DEVICE_ID
	hex
	default 0x65e1

config CONSOLE_POST
	bool
	default y

config ONBOARD_VGA_IS_PRIMARY
	bool
	default y

config UART_FOR_CONSOLE
	int
	default 2

config MAX_CPUS
	int
	default 16

config DIMM_MAX
	int
	default 2

config DIMM_SPD_SIZE
	int
	default 512

config VGA_BIOS_FILE
	string
	default "pci8086,9bc4.rom"

config VGA_BIOS_ID
	string
	default "8086,9bc4"

config FSP_M_XIP
	bool
	default y

config POST_DEVICE
	bool
	default n

endif
```

## src/mainboard/system76/adl-p/Kconfig.name
```kconfig
config BOARD_SYSTEM76_DARP8
	bool "darp8"

config BOARD_SYSTEM76_LEMP11
	bool "lemp11"
```

## src/mainboard/system76/adl/Kconfig.name
```kconfig
config BOARD_SYSTEM76_DARP8
	bool "darp8"

config BOARD_SYSTEM76_GALP6
	bool "galp6"

config BOARD_SYSTEM76_GAZE18_3050
	bool "gaze18-3050"

config BOARD_SYSTEM76_GAZE18_40X0
	bool "gaze18-40x0"

config BOARD_SYSTEM76_LEMP11
	bool "lemp11"

config BOARD_SYSTEM76_ORYP9
	bool "oryp9"

config BOARD_SYSTEM76_ORYP10
	bool "oryp10"

config BOARD_SYSTEM76_ORYP11
	bool "oryp11"
```
